/*
 * Generated 4-bit UI glyph coverage derived from Liberation Sans 2.1.5.
 * Digitized data copyright (c) 2010 Google Corporation.
 * Copyright (c) 2012 Red Hat, Inc.
 * Source TTF SHA256: 3e81ba4717a115f8d125cd2327d4a1246be2997b9ffd7291a45b6f84ed1a27d1
 * Generated with Pillow 10.2.0 and FreeType 2.13.2.
 * SPDX-License-Identifier: OFL-1.1
 */

static const uint8_t s_ui_label_bitmap[] = {
    0x00, 0x00, 0x00, 0x6a, 0xde, 0xfe, 0xc9, 0x40, 0x00, 0x00, 0x00, 0x00, 0x5e, 0xff, 0xff, 0xff,
    0xff, 0xfc, 0x20, 0x00, 0x00, 0x06, 0xff, 0xff, 0xfd, 0xce, 0xff, 0xff, 0xe3, 0x00, 0x00, 0x3f,
    0xff, 0xe6, 0x10, 0x00, 0x28, 0xff, 0xfc, 0x00, 0x00, 0xbf, 0xfd, 0x20, 0x00, 0x00, 0x00, 0x5f,
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    0x00, 0x00, 0x00, 0x00, 0x00, 0x00, 0xaf, 0xfa, 0x00, 0x00, 0x00, 0x00, 0x00,
};

static const lcd_font_glyph_t s_ui_label_glyphs[] = {
    {.data_offset = 0, .character = ' ', .width = 10, .height = 0,
     .advance = 10, .x_offset = 0, .y_offset = 0},
    {.data_offset = 0, .character = '?', .width = 20, .height = 25,
     .advance = 20, .x_offset = 0, .y_offset = -25},
    {.data_offset = 250, .character = 'A', .width = 24, .height = 25,
     .advance = 24, .x_offset = 0, .y_offset = -25},
    {.data_offset = 550, .character = 'C', .width = 26, .height = 25,
     .advance = 26, .x_offset = 0, .y_offset = -25},
    {.data_offset = 875, .character = 'D', .width = 26, .height = 25,
     .advance = 26, .x_offset = 0, .y_offset = -25},
    {.data_offset = 1200, .character = 'E', .width = 24, .height = 25,
     .advance = 24, .x_offset = 0, .y_offset = -25},
    {.data_offset = 1500, .character = 'F', .width = 22, .height = 25,
     .advance = 22, .x_offset = 0, .y_offset = -25},
    {.data_offset = 1775, .character = 'G', .width = 28, .height = 25,
     .advance = 28, .x_offset = 0, .y_offset = -25},
    {.data_offset = 2125, .character = 'I', .width = 10, .height = 25,
     .advance = 10, .x_offset = 0, .y_offset = -25},
    {.data_offset = 2250, .character = 'L', .width = 20, .height = 25,
     .advance = 20, .x_offset = 0, .y_offset = -25},
    {.data_offset = 2500, .character = 'N', .width = 26, .height = 25,
     .advance = 26, .x_offset = 0, .y_offset = -25},
    {.data_offset = 2825, .character = 'O', .width = 28, .height = 25,
     .advance = 28, .x_offset = 0, .y_offset = -25},
    {.data_offset = 3175, .character = 'P', .width = 24, .height = 25,
     .advance = 24, .x_offset = 0, .y_offset = -25},
    {.data_offset = 3475, .character = 'R', .width = 26, .height = 25,
     .advance = 26, .x_offset = 0, .y_offset = -25},
    {.data_offset = 3800, .character = 'S', .width = 24, .height = 25,
     .advance = 24, .x_offset = 0, .y_offset = -25},
    {.data_offset = 4100, .character = 'T', .width = 22, .height = 25,
     .advance = 22, .x_offset = 0, .y_offset = -25},
    {.data_offset = 4375, .character = 'U', .width = 26, .height = 25,
     .advance = 26, .x_offset = 0, .y_offset = -25},
    {.data_offset = 4700, .character = 'V', .width = 24, .height = 25,
     .advance = 24, .x_offset = 0, .y_offset = -25},
    {.data_offset = 5000, .character = 'W', .width = 34, .height = 25,
     .advance = 34, .x_offset = 0, .y_offset = -25},
    {.data_offset = 5425, .character = 'Y', .width = 24, .height = 25,
     .advance = 24, .x_offset = 0, .y_offset = -25},
};

static const lcd_font_t s_ui_label_font = {
    .bitmap = s_ui_label_bitmap,
    .glyphs = s_ui_label_glyphs,
    .glyph_count = sizeof(s_ui_label_glyphs) / sizeof(s_ui_label_glyphs[0]),
    .tracking = 0,
};

static const uint8_t s_ui_digit_bitmap[] = {
    0x00, 0x00, 0x00, 0x00, 0x00, 0x00, 0x00, 0x03, 0x7a, 0xce, 0xef, 0xed, 0xb9, 0x51, 0x00, 0x00,
    0x00, 0x00, 0x00, 0x00, 0x00, 0x00, 0x00, 0x00, 0x00, 0x00, 0x00, 0x17, 0xdf, 0xff, 0xff, 0xff,
    0xff, 0xff, 0xff, 0x93, 0x00, 0x00, 0x00, 0x00, 0x00, 0x00, 0x00, 0x00, 0x00, 0x00, 0x00, 0x06,
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    0x00, 0x00, 0x00, 0x00,
};

static const lcd_font_glyph_t s_ui_digit_glyphs[] = {
    {.data_offset = 0, .character = '0', .width = 42, .height = 54,
     .advance = 42, .x_offset = 0, .y_offset = -53},
    {.data_offset = 1134, .character = '1', .width = 42, .height = 52,
     .advance = 42, .x_offset = 0, .y_offset = -52},
    {.data_offset = 2226, .character = '2', .width = 42, .height = 53,
     .advance = 42, .x_offset = 0, .y_offset = -53},
    {.data_offset = 3339, .character = '3', .width = 42, .height = 54,
     .advance = 42, .x_offset = 0, .y_offset = -53},
    {.data_offset = 4473, .character = '4', .width = 42, .height = 52,
     .advance = 42, .x_offset = 0, .y_offset = -52},
    {.data_offset = 5565, .character = '5', .width = 42, .height = 53,
     .advance = 42, .x_offset = 0, .y_offset = -52},
    {.data_offset = 6678, .character = '6', .width = 42, .height = 54,
     .advance = 42, .x_offset = 0, .y_offset = -53},
    {.data_offset = 7812, .character = '7', .width = 42, .height = 52,
     .advance = 42, .x_offset = 0, .y_offset = -52},
    {.data_offset = 8904, .character = '8', .width = 42, .height = 54,
     .advance = 42, .x_offset = 0, .y_offset = -53},
    {.data_offset = 10038, .character = '9', .width = 42, .height = 54,
     .advance = 42, .x_offset = 0, .y_offset = -53},
};

static const lcd_font_t s_ui_digit_font = {
    .bitmap = s_ui_digit_bitmap,
    .glyphs = s_ui_digit_glyphs,
    .glyph_count = sizeof(s_ui_digit_glyphs) / sizeof(s_ui_digit_glyphs[0]),
    .tracking = 5,
};
