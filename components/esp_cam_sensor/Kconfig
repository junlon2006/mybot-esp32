## components/esp_codec_dev/Kconfig
```kconfig
menu "Audio Codec Device Configuration"

    config CODEC_I2C_BACKWARD_COMPATIBLE
        bool "Use the legacy I2C driver"
        default n
        help
            Use the legacy I2C driver instead of the ESP-IDF 5.3 and newer
            master-bus API.

    config CODEC_ES7210_SUPPORT
        bool "Support ES7210 codec"
        default n

    config CODEC_AW88298_SUPPORT
        bool "Support AW88298 codec"
        default n

endmenu
```

## components/esp_sccb_intf/Kconfig
```kconfig
# SPDX-License-Identifier: Apache-2.0
config ESP_SCCB_TRANS_TIMEOUT_DEFAULT
    int
    default 100
```

## components/mybot_platform/Kconfig.display
```kconfig
# SPDX-License-Identifier: Apache-2.0
config MYBOT_LVGL_UI
    bool
    default y
    help
        All display boards use LVGL. This capability is selected by MYBOT_BOARD.
```

## components/mybot_platform/Kconfig.headless
```kconfig
# SPDX-License-Identifier: Apache-2.0
config MYBOT_LVGL_UI
    bool
    default n
    help
        The selected board has no display and does not compile the LVGL backend.
```

## components/mybot_platform/boards/esp32-s3-touch-amoled-1.75c/sdkconfig.defaults
```kconfig
# SPDX-License-Identifier: MIT
# Copyright (c) 2025 Project Contributors

CONFIG_PARTITION_TABLE_CUSTOM=y
CONFIG_PARTITION_TABLE_CUSTOM_FILENAME="partitions/v2/16m.csv"

CONFIG_ESPTOOLPY_FLASHSIZE_16MB=y
CONFIG_ESPTOOLPY_FLASHMODE_QIO=y

CONFIG_SPIRAM=y
CONFIG_SPIRAM_MODE_OCT=y
CONFIG_SPIRAM_SPEED_80M=y

CONFIG_CODEC_ES8311_SUPPORT=y
CONFIG_CODEC_ES7210_SUPPORT=y
CONFIG_CODEC_I2C_BACKWARD_COMPATIBLE=n
```

## components/mybot_platform/boards/sensecap-watcher/sdkconfig.defaults
```kconfig
# SPDX-License-Identifier: MIT
# Copyright (c) 2025 Project Contributors

CONFIG_PARTITION_TABLE_CUSTOM=y
CONFIG_PARTITION_TABLE_CUSTOM_FILENAME="partitions/v2/32m-sensecap.csv"

CONFIG_ESPTOOLPY_FLASHSIZE_32MB=y
CONFIG_ESPTOOLPY_FLASHMODE_QIO=y
CONFIG_ESPTOOLPY_FLASH_MODE_AUTO_DETECT=n
CONFIG_IDF_EXPERIMENTAL_FEATURES=y
CONFIG_BOOTLOADER_CACHE_32BIT_ADDR_QUAD_FLASH=y

CONFIG_SPIRAM=y
CONFIG_SPIRAM_MODE_OCT=y
CONFIG_SPIRAM_SPEED_80M=y

CONFIG_CODEC_ES8311_SUPPORT=y
CONFIG_CODEC_ES7243E_SUPPORT=y
CONFIG_CODEC_I2C_BACKWARD_COMPATIBLE=n

CONFIG_IO_EXPANDER_ENABLE_GPIO_API_WRAPPER=n
```

## components/mybot_platform/boards/zhengchen-1.54tft-ml307/sdkconfig.defaults
```kconfig
CONFIG_PARTITION_TABLE_CUSTOM=y
CONFIG_PARTITION_TABLE_CUSTOM_FILENAME="partitions/v2/16m.csv"

CONFIG_ESPTOOLPY_FLASHSIZE_16MB=y
CONFIG_ESPTOOLPY_FLASHMODE_QIO=y

CONFIG_SPIRAM=y
CONFIG_SPIRAM_MODE_OCT=y
CONFIG_SPIRAM_SPEED_80M=y
```

## main/Kconfig.projbuild
```kconfig
menu "mybot"

    choice MYBOT_LANGUAGE
        prompt "Product language"
        default MYBOT_LANGUAGE_ZH_CN

        config MYBOT_LANGUAGE_ZH_CN
            bool "Chinese (zh-CN)"

        config MYBOT_LANGUAGE_EN_US
            bool "English (en-US)"
    endchoice

    config MYBOT_LANGUAGE_TAG
        string
        default "en-US" if MYBOT_LANGUAGE_EN_US
        default "zh-CN"

    config MYBOT_SERVER_BASE
        string "Device API server base URL"
        default "https://mybot.sh2.agoralab.co/api"

    choice MYBOT_AUDIO_PTIME
        prompt "Audio packet duration"
        default MYBOT_AUDIO_PTIME_60

        help
            The bundled ESP32-S3 Agora RTSA package emits 60 ms jitter-buffer frames.
            Selecting 20 ms or 40 ms requires a matching RTSA package and fails the
            component configuration check until that package is supplied.

        config MYBOT_AUDIO_PTIME_20
            bool "20 ms"

        config MYBOT_AUDIO_PTIME_40
            bool "40 ms"

        config MYBOT_AUDIO_PTIME_60
            bool "60 ms"
    endchoice

    config MYBOT_AUDIO_PTIME_MS
        int
        default 20 if MYBOT_AUDIO_PTIME_20
        default 40 if MYBOT_AUDIO_PTIME_40
        default 60 if MYBOT_AUDIO_PTIME_60

    config MYBOT_CLOUD_AEC
        bool "Enable cloud AEC"
        default y

    config MYBOT_AI_QOS
        bool "Enable Agora AI QoS"
        default y

    config MYBOT_FAST_SEND_MULTIPLIER
        int "Agora fast-send multiplier"
        range 1 5
        default 3

    config MYBOT_DEBUG_RESOURCE_MONITOR
        bool "Enable debug CPU and memory monitor"
        default n
        depends on !FREERTOS_SMP
        select FREERTOS_GENERATE_RUN_TIME_STATS
        help
            Log per-core busy time estimated from idle runtime deltas and heap
            statistics using a low-priority task. Adds scheduler accounting and
            serial logging overhead; intended for diagnostics only.

    config MYBOT_ENABLE_VIDEO
        bool "Enable CoreS3 camera JPEG uplink (1 fps)"
        default n
        select CAMERA_GC0308
        select CAMERA_GC0308_DVP_YUV422_YUYV_320X240_20FPS
        help
            Requires the m5stack-core-s3 board and a video-capable RTSA package.
            Uploads 320x240 JPEG images at most once per second while RTC is connected.
            The platform requests DVP capture at most five times per second.
            Capture and software encoding consume additional RAM and CPU.

    config MYBOT_AUDIO_PLAYBACK_TEST
        bool "Run CoreS3 offline audio playback A/B test at boot"
        default n
        depends on !MYBOT_ENABLE_VIDEO
        help
            CoreS3 only. Replaces normal startup with three 60-second tests of
            identical local PCM: timer-fed with capture, continuous with capture,
            and continuous without capture. Uses the saved speaker volume.
            Wi-Fi and mybot are not started. Disable and rebuild to resume normal use.

    config MYBOT_LVGL_UI_LIGHT_THEME
        bool "Use the LVGL light theme"
        depends on MYBOT_LVGL_UI
        default n
        help
            Select the light palette at build time. The default is the dark palette.

    config MYBOT_LVGL_UI_ANIMATIONS
        bool "Animate LVGL conversation status"
        depends on MYBOT_LVGL_UI
        default y
        help
            Animate small state indicators at up to 5 frames per second while
            listening, thinking or speaking. These are state animations, not an
            audio waveform. Overflowing provisioning text can still scroll
            when this option is disabled.

    config MYBOT_DEBUG_RESOURCE_MONITOR_INTERVAL_MS
        int "Resource monitor interval (ms)"
        depends on MYBOT_DEBUG_RESOURCE_MONITOR
        range 1000 60000
        default 5000

endmenu
```

## sdkconfig.defaults
```kconfig
CONFIG_COMPILER_OPTIMIZATION_SIZE=y
CONFIG_ESP_MAIN_TASK_STACK_SIZE=8192
CONFIG_FREERTOS_HZ=100

CONFIG_PARTITION_TABLE_CUSTOM=y
CONFIG_PARTITION_TABLE_CUSTOM_FILENAME="partitions/v2/16m.csv"
CONFIG_PARTITION_TABLE_OFFSET=0x8000

CONFIG_MBEDTLS_CERTIFICATE_BUNDLE=y
CONFIG_MBEDTLS_DYNAMIC_BUFFER=y
CONFIG_MBEDTLS_SSL_KEEP_PEER_CERTIFICATE=n
CONFIG_MBEDTLS_SSL_RENEGOTIATION=n

CONFIG_ESP_TASK_WDT_TIMEOUT_S=10
CONFIG_ESP_WIFI_IRAM_OPT=n
CONFIG_ESP_WIFI_RX_IRAM_OPT=n
CONFIG_ESP_WIFI_DYNAMIC_RX_MGMT_BUFFER=y
CONFIG_ESP_WIFI_ENTERPRISE_SUPPORT=n
CONFIG_LIBC_NEWLIB_NANO_FORMAT=n
```
